## deploy/buildroot/Config.in
```kconfig
source "$BR2_EXTERNAL_netifyd_PATH/package/netifyd/Config.in"
source "$BR2_EXTERNAL_netifyd_PATH/package/netify-proc-flow-actions/Config.in"
source "$BR2_EXTERNAL_netifyd_PATH/package/netify-proc-core/Config.in"
source "$BR2_EXTERNAL_netifyd_PATH/package/netify-proc-aggregator/Config.in"
source "$BR2_EXTERNAL_netifyd_PATH/package/netify-proc-dev-discovery/Config.in"
source "$BR2_EXTERNAL_netifyd_PATH/package/netify-proc-lua/Config.in"
source "$BR2_EXTERNAL_netifyd_PATH/package/netify-sink-http/Config.in"
source "$BR2_EXTERNAL_netifyd_PATH/package/netify-sink-log/Config.in"
source "$BR2_EXTERNAL_netifyd_PATH/package/netify-sink-mqtt/Config.in"
source "$BR2_EXTERNAL_netifyd_PATH/package/netify-sink-socket/Config.in"
```
